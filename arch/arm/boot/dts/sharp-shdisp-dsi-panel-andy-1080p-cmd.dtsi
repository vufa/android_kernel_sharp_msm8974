/* Copyright (c) 2012-2013, The Linux Foundation. All rights reserved.
 *
 * This program is free software; you can redistribute it and/or modify
 * it under the terms of the GNU General Public License version 2 and
 * only version 2 as published by the Free Software Foundation.
 *
 * This program is distributed in the hope that it will be useful,
 * but WITHOUT ANY WARRANTY; without even the implied warranty of
 * MERCHANTABILITY or FITNESS FOR A PARTICULAR PURPOSE.  See the
 * GNU General Public License for more details.
 */

&mdss_mdp {

	/*---------------------*/
	/* LCD Panel (MDP/DSI) */
	/*---------------------*/
	dsi_shdisp_andy: sharp,shdisp_andy {
		compatible = "qcom,mdss-dsi-panel";
		status = "disable";
		qcom,mdss-dsi-panel-name = "sharp 1080p cmd mode dsi panel";
		qcom,mdss-dsi-panel-controller = <&mdss_dsi0>;
        qcom,mdss-dsi-panel-type = "dsi_cmd_mode";
		qcom,mdss-dsi-panel-destination = "display_1";
        qcom,mdss-dsi-panel-framerate = <60>;
        qcom,mdss-dsi-virtual-channel-id = <0>;
        qcom,mdss-dsi-stream = <0>;
        qcom,mdss-dsi-panel-width = <1080>;
        qcom,mdss-dsi-panel-height = <1920>;
        qcom,mdss-dsi-h-front-porch = <120>;
        qcom,mdss-dsi-h-back-porch = <12>;
        qcom,mdss-dsi-h-pulse-width = <20>;
        qcom,mdss-dsi-h-sync-skew = <0>;
        qcom,mdss-dsi-v-back-porch = <4>;
        qcom,mdss-dsi-v-front-porch = <18>;
        qcom,mdss-dsi-v-pulse-width = <7>;
        qcom,mdss-dsi-h-left-border = <0>;
        qcom,mdss-dsi-h-right-border = <0>;
        qcom,mdss-dsi-v-top-border = <0>;
        qcom,mdss-dsi-v-bottom-border = <0>;
        qcom,mdss-dsi-bpp = <24>;
        qcom,mdss-dsi-color-order = "rgb_swap_rgb";
        qcom,mdss-dsi-underflow-color = <0xff>;
        qcom,mdss-dsi-border-color = <0>;
		qcom,mdss-dsi-on-command = [05 01 00 00 78 00 01 11
					15 01 00 00 0a 00 02 36 00
					15 01 00 00 0a 00 02 53 2c
					15 01 00 00 0a 00 02 51 ff
					15 01 00 00 0a 00 02 55 03
					05 01 00 00 0a 00 01 29];
		qcom,mdss-dsi-off-command = [05 01 00 00 78 00 01 10
					05 01 00 00 78 00 01 28
					15 01 00 00 0a 00 02 53 00
					15 01 00 00 0a 00 02 51 00];
		qcom,mdss-dsi-on-command-state = "dsi_lp_mode";
		qcom,mdss-dsi-off-command-state = "dsi_hs_mode";
        qcom,mdss-dsi-h-sync-pulse = <0>;
        qcom,mdss-dsi-traffic-mode = "non_burst_sync_event";
        qcom,mdss-dsi-lane-map = "lane_map_0123";
        qcom,mdss-dsi-bllp-eof-power-mode;
        qcom,mdss-dsi-bllp-power-mode;
        qcom,mdss-dsi-lane-0-state;
        qcom,mdss-dsi-lane-1-state;
        qcom,mdss-dsi-lane-2-state;
        qcom,mdss-dsi-lane-3-state;
        qcom,mdss-dsi-panel-timings = [e0 36 24 00 66 6c 2a 39 58 03 04 00];
        qcom,mdss-dsi-t-clk-post = <0x02>;
        qcom,mdss-dsi-t-clk-pre = <0x2f>;
        qcom,mdss-dsi-bl-min-level = <0>;
        qcom,mdss-dsi-bl-max-level = <22>;
        qcom,mdss-dsi-dma-trigger = "trigger_sw";
        qcom,mdss-dsi-mdp-trigger = "none";
        qcom,mdss-dsi-bl-pmic-control-type = "none";
        qcom,mdss-dsi-te-check-enable;
        qcom,mdss-dsi-te-using-te-pin;
        qcom,mdss-dsi-te-pin-select = <1>;
	};
};
