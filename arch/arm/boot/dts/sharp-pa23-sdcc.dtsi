/* Copyright (c) 2013, The Linux Foundation. All rights reserved.
 *
 * This program is free software; you can redistribute it and/or modify
 * it under the terms of the GNU General Public License version 2 and
 * only version 2 as published by the Free Software Foundation.
 *
 * This program is distributed in the hope that it will be useful,
 * but WITHOUT ANY WARRANTY; without even the implied warranty of
 * MERCHANTABILITY or FITNESS FOR A PARTICULAR PURPOSE.  See the
 * GNU General Public License for more details.
 */

/*
 * As a general rule, only version-specific property overrides should be placed
 * inside this file. However, device definitions should be placed inside the
 * msm8974.dtsi file.
 */

/* 
  Drive strength 
 */
&sdcc1 {
	qcom,pad-drv-on = <0x4 0x4 0x3>; /* 10mA, 10mA, 8mA */
};

&sdcc2 {
	qcom,pad-drv-on = <0x3 0x2 0x2>; /* 8mA, 6mA, 6mA */
};

&sdhc_1 {
	qcom,pad-drv-on = <0x4 0x4 0x3>; /* 10mA, 10mA, 8mA */
};

&sdhc_2 {
	qcom,pad-drv-on = <0x3 0x2 0x2>; /* 8mA, 6mA, 6mA */
};

