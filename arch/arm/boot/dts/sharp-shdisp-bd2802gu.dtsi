/* Copyright (c) 2012-2013, The Linux Foundation. All rights reserved.
 *
 * This program is free software; you can redistribute it and/or modify
 * it under the terms of the GNU General Public License version 2 and
 * only version 2 as published by the Free Software Foundation.
 *
 * This program is distributed in the hope that it will be useful,
 * but WITHOUT ANY WARRANTY; without even the implied warranty of
 * MERCHANTABILITY or FITNESS FOR A PARTICULAR PURPOSE.  See the
 * GNU General Public License for more details.
 */

&soc {
    sharp,shdisp_ledc {
        compatible = "sharp,shdisp_ledc";
        status = "disalbe";
        reset = <&pm8941_gpios 29 0>;
    };
};

&soc {
    /*---------------------*/
    /* BLSP1 QUP4(BLSP#5)  */
    /*---------------------*/
    blsp5_i2c: i2c@f9927000 {
        ledc_i2c@34 {
            compatible = "sharp,ledc_i2c";
            status = "disable";
            reg = <0x1A>;
        };
    };
};

