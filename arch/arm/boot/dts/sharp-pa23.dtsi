/* Copyright (c) 2012-2014, The Linux Foundation. All rights reserved.
 *
 * This program is free software; you can redistribute it and/or modify
 * it under the terms of the GNU General Public License version 2 and
 * only version 2 as published by the Free Software Foundation.
 *
 * This program is distributed in the hope that it will be useful,
 * but WITHOUT ANY WARRANTY; without even the implied warranty of
 * MERCHANTABILITY or FITNESS FOR A PARTICULAR PURPOSE.  See the
 * GNU General Public License for more details.
 */

/include/ "msm8974-leds.dtsi"
/include/ "sharp-pa23-shdisp.dtsi"
/include/ "sharp-pa23-pm8841.dtsi"
/include/ "sharp-pa23-pm8941.dtsi"
///include/ "sharp-pa23-sdcc.dtsi"

&soc {
    /*---------------------*/
    /* BLSP1 QUP0(BLSP#1)  */
    /*---------------------*/
    blsp1_spi: spi@f9923000 {
        status = "ok";
        spi-max-frequency = <50000000>;
        qcom,gpio-cs0 = <&msmgpio 2 0>;
        qcom,use-bam;
        spi-dma-threshold-sh = <48>;
    };

    /*---------------------*/
    /* BLSP1 QUP1(BLSP#2)  */
    /*---------------------*/
    blsp2_spi: spi@f9924000 {
        status = "ok";
        qcom,gpio-cs0 = <&msmgpio 6 0>;
        shtps_rmi@0 {
            status = "ok";
            compatible = "sharp,shtps_rmi";
            reg = <0>;
            spi-max-frequency = <400000>;
            interrupt-parent = <&msmgpio>;
            interrupts = <61 0>;
            spi-cpol;
            spi-cpha;
            shtps_rmi,rst_pin = <&pm8941_gpios 30 0>;
        };
    };

};
