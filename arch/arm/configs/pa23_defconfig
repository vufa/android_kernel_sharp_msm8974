## drivers/mmc/Kconfig
```kconfig
#
# MMC subsystem configuration
#

menuconfig MMC
	tristate "MMC/SD/SDIO card support"
	depends on HAS_IOMEM
	help
	  This selects MultiMediaCard, Secure Digital and Secure
	  Digital I/O support.

	  If you want MMC/SD/SDIO support, you should say Y here and
	  also to your specific host controller driver.

config MMC_DEBUG
	bool "MMC debugging"
	depends on MMC != n
	help
	  This is an option for use by developers; most people should
	  say N here.  This enables MMC core and driver debugging.

config MMC_PERF_PROFILING
	bool "MMC performance profiling"
	depends on MMC != n
	default n
	help
	  If you say Y here, support will be added for collecting
	  performance numbers at the MMC Queue and Host layers.

config MMC_CUST_SH
	bool "SHARP MMC driver customized"
	default n

config MMC_EMMC_CUST_SH
	bool "SHARP eMMC driver customized"
	depends on MMC && MMC_CUST_SH
	default n

config ERR_RETRY_EMMC_CUST_SH
	bool "SHARP MMC error retry customized"
	depends on MMC_EMMC_CUST_SH
	default n

config ERR_DETECT_EMMC_CUST_SH
	bool "SHARP MMC error detect customized"
	depends on MMC_EMMC_CUST_SH
	default n

config RW_PROTECT_EMMC_CUST_SH
	bool "SHARP MMC read/write protect customized"
	depends on MMC_EMMC_CUST_SH
	default n

config ACCESS_OPTIMIZE_EMMC_CUST_SH
	bool "SHARP MMC access optimization customized"
	depends on MMC_EMMC_CUST_SH
	default n

config TIMEOUTCTRL_EMMC_CUST_SH
	bool "SHARP MMC timeout control customized"
	depends on MMC_EMMC_CUST_SH
	default n

config HS200_TUNING_EMMC_CUST_SH
	bool "SHARP MMC HS200 tuning customized"
	depends on MMC_EMMC_CUST_SH
	default n

config MMC_SD_CUST_SH
	bool "SHARP SD operation customized"
	depends on MMC && MMC_CUST_SH
	default n

config MMC_SD_BATTLOG_CUST_SH
	bool "SHARP SD and logging customized"
	depends on MMC_SD_CUST_SH
	default n

config MMC_SD_ECO_MODE_CUST_SH
	bool "SHARP SD eco mode customized"
	depends on MMC_SD_CUST_SH
	default n

config MMC_SD_PENDING_RESUME_CUST_SH
	bool "SHARP SD pending resume customized"
	depends on MMC_SD_CUST_SH
	default n

config MMC_SDIO_CUST_SH
	bool "SHARP SDIO driver customized"
	depends on MMC && MMC_CUST_SH
	default n

config PM_EMMC_CUST_SH
	bool "SHARP MMC power management customized"
	depends on MMC_EMMC_CUST_SH
	default n

config DISCARD_EMMC_CUST_SH
	bool "SHARP MMC discard customized"
	depends on MMC_EMMC_CUST_SH
	default n

config USE_QOS_WITH_TIMEOUT_MMC_CUST_SH
	bool "SHARP MMC use qos with timeout customized"
	depends on MMC && MMC_CUST_SH
	default n

config RESET_CLK_SCALING_PARAM_MMC_CUST_SH
	bool "SHARP reset parameters of clk scaling customized"
	depends on MMC && MMC_CUST_SH
	default n

if MMC

source "drivers/mmc/core/Kconfig"

source "drivers/mmc/card/Kconfig"

source "drivers/mmc/host/Kconfig"

endif # MMC
```

## drivers/sharp/Kconfig
```kconfig
#
# SHARP configuration
#

menu "SHARP Device Drivers"

source "drivers/sharp/mfc/Kconfig"

source "drivers/sharp/shdiag/Kconfig"
source "drivers/sharp/shmds/Kconfig"

#CONFIG_SH_AUDIO_DRIVER-> 03-004
source "drivers/sharp/shaudio/Kconfig"
#CONFIG_SH_AUDIO_DRIVER<- 03-004

source "drivers/sharp/tunerdrv/Kconfig"
source "drivers/sharp/tunerdrv_tmm/Kconfig"

#source "drivers/sharp/btpm/Kconfig"
source "drivers/sharp/proximity/Kconfig"
source "drivers/sharp/shbatt/Kconfig"

#source "drivers/sharp/shirda/Kconfig"

source "drivers/sharp/shterm/Kconfig"

source "drivers/sharp/shlog/Kconfig"

source "drivers/sharp/wifi/Kconfig"

#source "drivers/sharp/bthid/Kconfig"

source "drivers/sharp/vold/Kconfig"

#source "drivers/sharp/presenter/Kconfig"

source "drivers/sharp/shtimer/Kconfig"

#source "drivers/sharp/shmhl/Kconfig"

#source "drivers/sharp/wtap/Kconfig"

source "drivers/sharp/shdisp/Kconfig"

#source "drivers/sharp/shcts/Kconfig"

source "drivers/sharp/shtps/Kconfig"

source "drivers/sharp/shcamled/Kconfig"

source "drivers/sharp/shirda/Kconfig"

source "drivers/sharp/shgrip/Kconfig"

source "drivers/sharp/shvibrator/Kconfig"

endmenu
```

## drivers/sharp/mfc/Kconfig
```kconfig
#
# FeliCa device configuration
#

menu "FeliCa driver"

comment "SHARP FeliCa device drivers"

config SHFELICA
	bool "FeliCa device drivers"
	depends on SERIAL_MSM_HSL && I2C
	default y
	help
	  Enable FeliCa driver.

config SHSNFC
	bool "NFC device drivers"
	depends on SHFELICA
	default y
	help
	  Enable NFC driver.

config SHSNFC_BATTERY_FIXATION
	bool "MVDD device drivers"
	depends on SHFELICA
	default y
	help
	  Enable MVDD device drivers.

endmenu
```

## drivers/sharp/proximity/Kconfig
```kconfig
#
# Proximity device configuration
#
# drivers/sharp/proximity/Kconfig

menu "Proximity Configuration"

config SENSORS_PROXIMITY
	tristate "Proximity Sensor Driver"
	default n

config PROXIMITY_MODEL_TYPE
	int "PROXIMITY MODEL TYPE"
	depends on SENSORS_PROXIMITY
	range 0 6
	default "0"

choice
    prompt "Proximity interrupt Setting"
    depends on SENSORS_PROXIMITY
    default PROXIMITY_INT_UNDEFINED

config PROXIMITY_INT_UNDEFINED
    bool "Undefined "
    depends on SENSORS_PROXIMITY

config PROXIMITY_INT_IR
    bool "connected to IR "
    depends on SENSORS_PROXIMITY

config PROXIMITY_INT_HOST
    bool "connected to Host "
    depends on SENSORS_PROXIMITY

endchoice

endmenu
```

## drivers/sharp/shaudio/Kconfig
```kconfig
#
# audio device configuration
#
# CONFIG_SH_AUDIO_DRIVER newly created

menu "SHARP audio driver"

comment "SHARP audio drivers"

#/*SH_AUDIO_DRIVER->*//*05-010*/
config SH_AUDIO_DRIVER_MODEL_NUMBER
        int "SH_AUDIO_DRIVER_MODEL_NUMBER"
        range 0 999
        default "0"
#/*SH_AUDIO_DRIVER<-*//*05-010*/

config SH_AUDIO_DRIVER
	tristate "SHARP Audio Driver customized"
	default y

config SHSPAMP_YDA168B
	tristate "SHARP spamp yda168b"
	default n

endmenu
```

## drivers/sharp/shbatt/Kconfig
```kconfig
#
# Battery Control Configuration
#

menu "SHARP Battery Driver"

comment "Battery Control Configuration"

config PM_APQ_THERM
	bool "APQ_THERM support"
	default n

config PM_WIRELESS_CHARGE
	bool "SHARP Wireless Charger support"
	default n

config PM_SUPPORT_BATT_AUTH
	bool "SHARP Battery Authentication support"
	default n

config PM_WIRELESS_CHARGE_IC_ACCESS_I2C
	bool "SHARP Wireless Charger IC access by I2C"
	default n
	depends on PM_WIRELESS_CHARGE

#config PM_SHBATT_WAKE_CTL_ENABLE
#	bool "SHBATT_WAKE_CTL ENABLE in notify_charger_cable_status"
#	default n

config PM_CPU_CLOCK_LEVEL_TYPE
	int "CPU clock level type"
	range 0 9
	default 0

config PM_ICHG_POWER_ENABLE
	bool "ICHG power enable"
	default n

config PM_MSM_XO_VOTE_ENABLE
	bool "MSM_XO_VOTE enable"
	default n

config PM_SUPPORT_BIF
	bool "SHARP BIF support"
	default n

endmenu
```

## drivers/sharp/shcamled/Kconfig
```kconfig
#
# Camera Picture Light LED Configration
#

menu "SHARP Camera LED"

comment "SHARP Camera LED"

config SHCAMERA_PICT
        bool "Sharp Camera Picture Light"
        default n
        ---help---
          This flag enables Sharp Camera Picture Light.

endmenu
```

## drivers/sharp/shdiag/Kconfig
```kconfig
#
# SHDiag device configuration
#

menu "SHDiag driver"

comment "SHARP Diag device drivers"

config SHDIAG
	bool "SHDiag Support"
	depends on SHSYS_CUST
	default y
	help
	  SHDiag Support.

config SHDIAG_MODE
	bool "SHDiag device drivers (mode read)"
	depends on SHDIAG
	default y
	help
	  Enable SHDiag driver(mode read).

endmenu
```

## drivers/sharp/shdisp/Kconfig
```kconfig
#
# LCDC Configuration
#

menu "LCDC Configuration"

config USES_SHLCDC
	bool "There is USES_SHLCDC"


endmenu
```

## drivers/sharp/shgrip/Kconfig
```kconfig
#
# SHARP Grip Sensor Driver configuration
#

menu "Grip Sensor Driver configuration"

config SENSOR_SHGRIP
        bool "SHARP Grip Sensor Driver"
        default n

endmenu
```

## drivers/sharp/shlog/Kconfig
```kconfig
# drivers/sharp/shterm/Kconfig

menu "SHLOG_SYSTEM"

comment "SHLOG_SYSTEM"

config SHLOG_SYSTEM
bool "SHLOG_SYSTEM driver"
default y

endmenu
```

## drivers/sharp/shmds/Kconfig
```kconfig
menuconfig SHMDS
	bool "Motion Sensor Drivers"
	default y

if SHMDS
#source "drivers/sharp/shmds/mpu3050/Kconfig"
#source "drivers/sharp/shmds/ami603/Kconfig"
source "drivers/sharp/shmds/mpu9150/Kconfig"

endif
```

## drivers/sharp/shmds/mpu9150/Kconfig
```kconfig
#
# inv-mpu drivers for Invensense MPU devices and combos
#
# shmds mod 1-2 S
config MPU_SENSORS_MPU9150
# shmds mod 1-2 E
    tristate "Invensense MPU9150 devices"
    depends on I2C && SYSFS && INPUT && INPUT_EVDEV
    default n
    help
      This driver supports the Invensense MPU devices.
      This driver can be built as a module. The module will be called
      inv-mpu.

# shmds add 5-1 S
choice
	prompt "SHMDS POLARITY"
	depends on MPU_SENSORS_MPU9150
	default SHMDS_POLARITY_0
	
config SHMDS_POLARITY_0
	bool "Polarity_Normal"
	help
	  Polarity_Normal.

config SHMDS_POLARITY_1
	bool "Polarity_Custom1"
	help
	  Polarity_Custom1.

config SHMDS_POLARITY_2
	bool "Polarity_Custom2"
	help
	  Polarity_Custom2.
	  
endchoice
# shmds add 5-1 E
```

## drivers/sharp/shterm/Kconfig
```kconfig
# drivers/sharp/shterm/Kconfig

menu "SHTERM"

comment "SHTERM"

config SHTERM
bool "SHTERM driver"
default y

endmenu
```

## drivers/sharp/shtimer/Kconfig
```kconfig
# drivers/sharp/shtimer/Kconfig

menu "SHTIMER"

comment "SHTIMER"

config SHTIMER
bool "SHARP Timer"
default y

endmenu
```

## drivers/sharp/shtps/Kconfig
```kconfig
#
# Sharp Touchscreen configuration
#

menu "SHTPS driver"

comment "SHARP Touchscreen device drivers"

config TOUCHSCREEN_SHTPS
	bool "SHARP Touchscreens"
	default n

if TOUCHSCREEN_SHTPS
	source "drivers/sharp/shtps/sy3000/Kconfig"

endif # TOUCHSCREEN_SHTPS

endmenu
```

## drivers/sharp/shtps/sy3000/Kconfig
```kconfig
#
# Sharp Touchscreen configuration
#

if TOUCHSCREEN_SHTPS

	config SHTPS_SY3X00_DEV
		tristate "SY3x00 Device"
		default n
		depends on TOUCHSCREEN_SHTPS

	config SHTPS_SY3000_TM2851_001
		tristate "SY3000 TM2851-001"
		default n
		depends on SHTPS_SY3X00_DEV

	config SHTPS_SY3000_TM2858_001
		tristate "SY3000 TM2858-001"
		default n
		depends on SHTPS_SY3X00_DEV

	config SHTPS_SY3000_TM2868_001
		tristate "SY3000 TM2868-001"
		default n
		depends on SHTPS_SY3X00_DEV

	config SHTPS_SY3000_TM2914_001
		tristate "SY3000 TM2914-001"
		default n
		depends on SHTPS_SY3X00_DEV

	config SHTPS_SY3000_TM2923_001
		tristate "SY3000 TM2923-001"
		default n
		depends on SHTPS_SY3X00_DEV

	config SHTPS_SY3000_TM2923_002
		tristate "SY3000 TM2923-002"
		default n
		depends on SHTPS_SY3X00_DEV

	config SHTPS_SY3000_TM2932_001
		tristate "SY3000 TM2932-001"
		default n
		depends on SHTPS_SY3X00_DEV

endif # TOUCHSCREEN_SHTPS
```

## drivers/sharp/shvibrator/Kconfig
```kconfig
#
# Sharp Linear Vibrator Driver configuration
#

menu "SHVIBRATOR driver"

comment "SHARP Linear Vibrator drivers"

config SHVIBRATOR_LINEAR
	bool "SHARP Linear Vibrator"
	default n

config SHVIBRATOR_MODEL_TYPE
	int "SHVIBRATOR MODEL TYPE"
	depends on SHVIBRATOR_LINEAR
	range 0 5
	default "0"

endmenu
```

## drivers/sharp/tunerdrv/Kconfig
```kconfig
# drivers/sharp/tunerdrv/Kconfig

menu "DTV Tuner Configuration"

config DTV_TUNERDEV
	bool "set DTV tuner dev."
	default n


endmenu
```

## drivers/sharp/tunerdrv_tmm/Kconfig
```kconfig
# drivers/sharp/tunerdrv/Kconfig

menu "DTV Tuner Configuration(Tmm)"

config DTV_TUNERDEV_TMM
	bool "set DTV tuner dev.(Tmm)"
	default n


endmenu
```

## drivers/sharp/vold/Kconfig
```kconfig
#
# vold configuration
#
menu "SHARP Check process for vold (SHVOLD_KILLPROCESS)"

config SHVOLD_KILLPROCESS
	bool "SHARP Kill process system for SD"
	default y

endmenu
```

## drivers/sharp/wifi/Kconfig
```kconfig
# drivers/sharp/wifi/Kconfig

menu "Wi-Fi Configuration"

comment "Qualcomm Atheros Pronto WLAN module"
config PRONTO_WLAN
	tristate "Qualcomm Atheros Pronto WLAN module"
	default n
	help
	Add support for the Qualcomm Atheros Pronto WLAN module

#	depends on WLAN
#	depends on CFG80211
#	depends on WCNSS_CORE


config SHWLAN_RSSI_OFFSET
    int "WLAN RSSI Offset value"
    range -20 20
    default 0
    help
      RSSI Offset for WLAN.
      Examples:
        Actual RSSI:-40dBm + SH_RSSI_OFFSET:0    => -40dBm
        Actual RSSI:-40dBm + SH_RSSI_OFFSET:-20  => -60dBm
        Actual RSSI:-40dBm + SH_RSSI_OFFSET:20   => -20dBm

config HEART_BEAT_THRESHOLD_STADEF
    int "WLAN Heart Beat Threshold"
    range 0 10000
    default 0
    help
      The number of beacon misses that the connected AP would be considered as out of range.

endmenu
```

## drivers/usb/dwc3/Kconfig
```kconfig
config USB_DWC3
	tristate "DesignWare USB3 DRD Core Support"
	depends on (USB || USB_GADGET)
	select USB_OTG_UTILS
	select USB_XHCI_PLATFORM if USB_SUPPORT && USB_XHCI_HCD
	help
	  Say Y or M here if your system has a Dual Role SuperSpeed
	  USB controller based on the DesignWare USB3 IP Core.

	  If you choose to build this driver is a dynamically linked
	  module, the module will be called dwc3.ko.

if USB_DWC3

config USB_DWC3_DEBUG
	bool "Enable Debugging Messages"
	help
	  Say Y here to enable debugging messages on DWC3 Driver.

config USB_DWC3_VERBOSE
	bool "Enable Verbose Debugging Messages"
	depends on USB_DWC3_DEBUG
	help
	  Say Y here to enable verbose debugging messages on DWC3 Driver.

config USB_DWC3_SH_CUST
	boolean "Sharp Custamize for DWC3 Driver"
	depends on USB_DWC3 && USB_ANDROID_SH_CUST
	help
		Add sharp custamize for DWC3 Driver.

config USB_DWC3_SH_CUST_EYEPATTERN
	bool "Eye Diagram adjustment"
	depends on USB_DWC3_SH_CUST
	default n
	help
		Enable this to adjust eye pattern for sharp devices.

config USB_DWC3_HS_DC_LEVEL_PERIPHERAL
	int "Adjusts the HS DC level voltage for peripheral mode (0-15)"
	range 0 15
	depends on USB_DWC3_SH_CUST_EYEPATTERN
	default 3
	help
		Adjusts the DC level voltage for good eye patern of high-speed USB.

config USB_DWC3_HS_DC_LEVEL_HOST
	int "Adjusts the HS DC level voltage for host mode (0-15)"
	range 0 15
	depends on USB_DWC3_SH_CUST_EYEPATTERN
	default 3
	help
		Adjusts the DC level voltage for good eye patern of high-speed USB.

config USB_DWC3_EXT5V_EXCLUSIVE
	bool "Support for EXT5V exclusive control"
	depends on USB_DWC3_SH_CUST && TPS_DRIVER
	default n
	help
		To exclusive control about EXT5V regurator
		between USB host and camera LED.

config USB_DWC3_READ_USB_ID_FROM_ADC
	bool "Read USB_ID from ADC"
	depends on USB_DWC3_SH_CUST && BATTERY_SH
	default n
	help
		Enable this to support the reading USB_ID from ADC.

config USB_DWC3_LIMIT_LOCK
	bool "Support for limitlock"
	depends on USB_DWC3_SH_CUST && SHSYS_CUST_PERFLOCK
	default n
	help
		Enable this to support the limit lock.
endif
```
